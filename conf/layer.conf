## conf/layer.conf
```bitbake
BBPATH .= ":${LAYERDIR}"

BBFILES += "${LAYERDIR}/recipes-*/*/*.bb \
            ${LAYERDIR}/recipes-*/*/*.bbappend \
"
BBFILE_COLLECTIONS += "meta-ivysochyn"
BBFILE_PATTERN_meta-ivysochyn := "^${LAYERDIR}/"
BBFILE_PRIORITY_meta-ivysochyn = "6"

LAYERDEPENDS_meta-ivysochyn = " \
    core \
    meta-antmicro-common \
"

LAYERSERIES_COMPAT_meta-ivysochyn = "kirkstone"
```
